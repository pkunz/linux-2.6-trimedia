## ltt/Kconfig
```kconfig
config LTT
	bool "Linux Trace Toolkit Instrumentation Support"
	select RELAYFS_FS
	select LTT_FACILITY_CORE
	depends on !X86_64 && EXPERIMENTAL
	select LTT_HEARTBEAT if MIPS
	select LTT_SYNTHETIC_TSC if MIPS
	default n
	help
	  It is possible for the kernel to log important events to a trace
	  facility. Doing so, enables the use of the generated traces in order
	  to reconstruct the dynamic behavior of the kernel, and hence the
	  whole system.

	  The tracing process contains 4 parts :
	      1) The logging of events by key parts of the kernel.
	      2) The tracer that keeps the events in a data buffer (uses
	         relayfs).
	      3) A trace daemon that interacts with the tracer and is
	         notified every time there is a certain quantity of data to
	         read from the tracer.
	      4) A trace event data decoder that reads the accumulated data
	         and formats it in a human-readable format.

	  If you say Y, the first component will be built into the kernel.

	  For more information on kernel tracing, the trace daemon or the event
	  decoder, please check the following address :
	       http://www.opersys.com/ltt
	  See also the experimental page of the project :
	       http://ltt.polymtl.ca

config LTT_TRACER
	tristate "Linux Trace Toolkit Tracer"
	select RELAYFS_FS
	depends on LTT
	default y
	help
	  If you enable this option, the Linux Trace Toolkit Tracer will be
	  either built in the kernel of as module.

	  Critical parts of the kernel will call upon the kernel tracing
	  function. The data is then recorded by the tracer if a trace daemon
	  is running in user-space and has issued a "start" command.

	  For more information on kernel tracing, the trace daemon or the event
	  decoder, please check the following address :
	       http://www.opersys.com/ltt
	  See also the experimental page of the project :
	       http://ltt.polymtl.ca

config LTT_ALIGNMENT
	bool "Align Linux Trace Toolkit Traces"
	depends on LTT
	default y
	help
	  This option enables dynamic alignment of data in buffers. The
	  alignment is made on the smallest size between architecture size
	  and the size of the value to be written.

	  Dynamically calculating the offset of the data has a performance cost,
	  but it is more efficient on some architectures (especially 64 bits) to
	  align data than to write it unaligned.

config LTT_HEARTBEAT
	bool "Activate Linux Trace Toolkit Heartbeat Timer"
	depends on LTT
	default n
	help
	  The Linux Trace Toolkit Heartbeat Timer fires at an interval small
	  enough to guarantee that the 32 bits truncated TSC won't overflow
	  between two timer execution.

config LTT_HEARTBEAT_EVENT
	bool "Write heartbeat event to shrink traces"
	depends on LTT_HEARTBEAT
	default y
	help
	  This option makes the heartbeat timer write an event in each tracefile
	  at an interval that is one tenth of the time it takes to overflow 32
	  bits at your CPU frequency.

	  If this option is not enabled, 64 bits fields must be used in each
	  event header to save the full TSC : it can make traces about 1/10
	  bigger. It is suggested that you enable this option to make more
	  compact traces.

config LTT_SYNTHETIC_TSC
	bool "Keep a synthetic cpu timestamp counter"
	depends on LTT_HEARTBEAT
	default n
	help
	  This option is only useful on archtecture lacking a 64 bits timestamp
	  counter : it generates a "synthetic" 64 bits timestamp by updating
	  the 32 MSB at each heartbeat atomically. See kernel/ltt-heartbeat.c
	  for details.

config LTT_USERSPACE_GENERIC
	bool "Allow tracing from userspace"
	depends on LTT
	default y
	help
	  This options allows processes to trace through the ltt_trace_generic
	  system call after they have registered their facilities with
	  ltt_register_generic.

config LTT_NETLINK_CONTROL
	tristate "Linux Trace Toolkit Netlink Controller"
	depends on LTT_TRACER
	default m
	help
	  If you enable this option, the Linux Trace Toolkit Netlink Controller
	  will be either built in the kernel of as module.

config LTT_STATEDUMP
	tristate "Linux Trace Toolkit State Dump"
	depends on LTT_TRACER
	default m
	help
	  If you enable this option, the Linux Trace Toolkit State Dump will
	  be either built in the kernel of as module.

	  This module saves the state of the running kernel at trace start
	  into the trace buffers along with the ongoing tracing information.

config LTT_FACILITY_CORE
	bool "Linux Trace Toolkit Core Facility"
	depends on LTT
	default y
	help
	  LTT core facility. Contains event definition for facility load/unload
	  and heartbeat.

config LTT_FACILITY_FS
	bool "Linux Trace Toolkit File System Facility"
	depends on LTT
	default y
	help
	  LTT file system facility. Contains event definition for filesystem
	  related events.

config LTT_FACILITY_FS_DATA
	bool "Linux Trace Toolkit File System Facility Data Log"
	depends on LTT
	default y
	help
	  LTT file system data log facility. Logs the beginning of data sent
	  through read and write system calls.

config LTT_FACILITY_IPC
	bool "Linux Trace Toolkit Inter-Process Communication Facility"
	depends on LTT
	default y
	help
	  LTT IPC facility. Contains event definition for inter-process
	  communication events.

config LTT_FACILITY_KERNEL
	bool "Linux Trace Toolkit Kernel Facility"
	depends on LTT
	default y
	help
	  LTT Kernel facility. Contains event definition for tasklet, irq,
	  system calls, traps, soft irq events.

config LTT_FACILITY_KERNEL_ARCH
	bool "Linux Trace Toolkit Kernel Arch Specific Facility"
	depends on LTT
	default y
	help
	  LTT Kernel facility. Contains event definition for system calls in an
	  enumeration that matches the architecture.

config LTT_FACILITY_LOCKING
	bool "Linux Trace Toolkit Locking Facility"
	depends on LTT
	default n
	help
	  LTT locking facility. Traces currently only interrupt save/restore and
	  disable/enable.

config LTT_FACILITY_MEMORY
	bool "Linux Trace Toolkit Memory Facility"
	depends on LTT
	default y
	help
	  LTT Memory facility. Contains event definition for memory management
	  related events.

config LTT_FACILITY_NETWORK
	bool "Linux Trace Toolkit Network Facility"
	depends on LTT
	default y
	help
	  LTT Network facility. Contains event definition for network subsystem.

config LTT_FACILITY_NETWORK_IP_INTERFACE
        bool "Linux Trace Toolkit Network IP Interface Facility"
        depends on LTT
        default y
        help
	  LTT Network IP Interface facility. Contains event definition for
	  network device state.

config LTT_FACILITY_PROCESS
	bool "Linux Trace Toolkit Process Facility"
	depends on LTT
	default y
	help
	  LTT Process facility. Contains event definition for process management
	  and scheduling.

config LTT_FACILITY_SOCKET
	bool "Linux Trace Toolkit Socket Facility"
	depends on LTT
	default y
	help
	  LTT Socket facility. Contains event definition for sockets.

config LTT_FACILITY_STATEDUMP
	bool "Linux Trace Toolkit Kernel State Dump Facility"
	depends on LTT
	default y
	help
	  LTT Kernel State Dump facility. Contains events for dumping kernel
	  state at the beginning of a trace.

config LTT_FACILITY_TIMER
	bool "Linux Trace Toolkit Timer Facility"
	depends on LTT
	default y
	help
	  LTT Timer facility. Contains events for timers.

config LTT_FACILITY_STACK_ARCH
	bool "Get complete process stack in system call (EXPERIMENTAL)"
	depends on LTT
	depends on X86
	default n
	help
	  Get complete process stack upon system call (architecture specific)
```

## net/ipv6/Kconfig
```kconfig
#
# IPv6 configuration
#

#   IPv6 as module will cause a CRASH if you try to unload it
config IPV6
	tristate "The IPv6 protocol"
	default m
	select CRYPTO if IPV6_PRIVACY
	select CRYPTO_MD5 if IPV6_PRIVACY
	---help---
	  This is complemental support for the IP version 6.
	  You will still be able to do traditional IPv4 networking as well.

	  For general information about IPv6, see
	  <http://playground.sun.com/pub/ipng/html/ipng-main.html>.
	  For Linux IPv6 development information, see <http://www.linux-ipv6.org>.
	  For specific information about IPv6 under Linux, read the HOWTO at
	  <http://www.bieringer.de/linux/IPv6/>.

	  To compile this protocol support as a module, choose M here: the 
	  module will be called ipv6.

config IPV6_PRIVACY
	bool "IPv6: Privacy Extensions support"
	depends on IPV6
	---help---
	  Privacy Extensions for Stateless Address Autoconfiguration in IPv6
	  support.  With this option, additional periodically-alter 
	  pseudo-random global-scope unicast address(es) will assigned to
	  your interface(s).
	
	  By default, kernel do not generate temporary addresses.
	  To use temporary addresses, do
	
	        echo 2 >/proc/sys/net/ipv6/conf/all/use_tempaddr 

	  See <file:Documentation/networking/ip-sysctl.txt> for details.

config IPV6_PRIVACY_MD5
	bool "IPv6: Use RFC 3041 randomized interface identifiers"
	depends on IPV6_PRIVACY
	---help---
	  Instead of standard pseudo random generator, use
	  traditional algorithm described in the original RFC 3041.

config IPV6_ROUTER_PREF
	bool "IPv6: default router preference"
	depends on IPV6

config IPV6_NEW_ROUNDROBIN
	bool
	depends on IPV6_ROUTER_PREF
	default y

config INET6_AH
	tristate "IPv6: AH transformation"
	depends on IPV6
	select XFRM
	select CRYPTO
	select CRYPTO_HMAC
	select CRYPTO_MD5
	select CRYPTO_SHA1
	---help---
	  Support for IPsec AH.

	  If unsure, say Y.

config INET6_ESP
	tristate "IPv6: ESP transformation"
	depends on IPV6
	select XFRM
	select CRYPTO
	select CRYPTO_HMAC
	select CRYPTO_MD5
	select CRYPTO_SHA1
	select CRYPTO_DES
	---help---
	  Support for IPsec ESP.

	  If unsure, say Y.

config INET6_IPCOMP
	tristate "IPv6: IPComp transformation"
	depends on IPV6
	select XFRM
	select INET6_TUNNEL
	select CRYPTO
	select CRYPTO_DEFLATE
	---help---
	  Support for IP Payload Compression Protocol (IPComp) (RFC3173),
	  typically needed for IPsec.

	  If unsure, say Y.

config INET6_TUNNEL
	tristate "IPv6: tunnel transformation"
	depends on IPV6
	select XFRM
	---help---
	  Support for generic IPv6-in-IPv6 tunnel transformation, which is
	  required by the IPv6-in-IPv6 tunneling module as well as tunnel mode
	  IPComp.

	  If unsure, say Y.

config IPV6_TUNNEL
	tristate "IPv6: IPv6-in-IPv6 tunnel"
	depends on IPV6
	---help---
	  Support for IPv6-in-IPv6 tunnels described in RFC 2473.

	  If unsure, say N.

config IPV6_ADVANCED_ROUTER
	bool "IPv6: advanced router (EXPERIMENTAL)"
	depends on IPV6 && EXPERIMENTAL
	---help---
	  If you intend to run your Linux box mostly as an IPv6 router
	  or otherwise need more advanced routing features, say Y; you
	  will then be presented with several options that allow more
	  precise control about the routing process.

	  The answer to this question won't directly affect the kernel:
	  answering N will just cause the configurator to skip all the
	  questions about advanced routing.

	  If unsure, say N.

config IPV6_MULTIPLE_TABLES
	bool "IPv6: policy routing"
	depends on IPV6_ADVANCED_ROUTER
	---help---
	  Normally, a router decides what to do with a received packet based
	  solely on the packet's final destination address.  If you say Y here,
	  the Linux router will also be able to take the packet's source
	  address and incoming interface into account.

	  If unsure, say N.

config IPV6_SUBTREES
	bool "IPv6: source address based routing"
	depends on IPV6_MULTIPLE_TABLES
	---help---
	  Enable policy routing by source address or prefix.  To set up source
	  address based routing you need to define source prefix specific
	  policy rules using iproute2 or a similar tool.

	  As the first matching policy rule is always applied, policy rules
	  should be ordered by decreasing source and destination prefix length,
	  with the exception of the preconfigured special local rule.

	  The destination address is still the primary routing key, so mixing
	  normal and source prefix specific routes in the same routing table
	  may sometimes lead to unintended routing behavior.  This can be
	  avoided by defining different routing tables for the normal and
	  source prefix specific routes.

	  If unsure, say N.

config IPV6_MIP6
	bool "IPv6: Mobility (EXPERIMENTAL)"
	depends on IPV6 && EXPERIMENTAL
	select XFRM
	select XFRM_USER
	select XFRM_ENHANCEMENT
	---help---
	  Support for IPv6 Mobility.

	  If unsure, say N.

config IPV6_MIP6_DEBUG
	bool "IPv6: Moblity Debug Message"
	depends on IPV6_MIP6
	---help---
	  Be sure to say Y and record debug messages when submitting a
	  bug report.
	  If unsure, say N.

config IPV6_MROUTE
	bool "IPv6: multicast routing (EXPERIMENTAL)"
	depends on IPV6 && EXPERIMENTAL
	---help---
	  Experimental support for IPv6 multicast forwarding.
	  If unsure, say N.

config IPV6_PIMSM_V2
	bool "IPv6: PIM-SM version 2 support (EXPERIMENTAL)"
	depends on IPV6_MROUTE
	---help---
	  Support for IPv6 PIM multicast routing protocol PIM-SMv2.
	  If unsure, say N.

config IPV6_STATISTICS
	bool "IPv6: per-interface statistics for SNMP"
	depends on IPV6 && EXPERIMENTAL

config IPV6_STATISTICS_DEBUG
	bool "IPv6: debug per-interface statistics for SNMP"
	depends on IPV6_STATISTICS
	---help---
	  Say N.
```
