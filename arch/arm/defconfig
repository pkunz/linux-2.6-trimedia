## lib/Kconfig.debug
```kconfig
config PRINTK_TIME
	bool "Show timing information on printks"
	help
	  Selecting this option causes timing information to be
	  included in printk output.  This allows you to measure
	  the interval between kernel operations, including bootup
	  operations.  This is useful for identifying long delays
	  in kernel startup.


config DEBUG_KERNEL
	bool "Kernel debugging"
	help
	  Say Y here if you are developing drivers or trying to debug and
	  identify kernel problems.

config MAGIC_SYSRQ
	bool "Magic SysRq key"
	depends on DEBUG_KERNEL && !UML
	help
	  If you say Y here, you will have some control over the system even
	  if the system crashes for example during kernel debugging (e.g., you
	  will be able to flush the buffer cache to disk, reboot the system
	  immediately or dump some status information). This is accomplished
	  by pressing various keys while holding SysRq (Alt+PrintScreen). It
	  also works on a serial console (on PC hardware at least), if you
	  send a BREAK and then within 5 seconds a command keypress. The
	  keys are documented in <file:Documentation/sysrq.txt>. Don't say Y
	  unless you really know what this hack does.

config LOG_BUF_SHIFT
	int "Kernel log buffer size (16 => 64KB, 17 => 128KB)" if DEBUG_KERNEL
	range 12 21
	default 17 if ARCH_S390
	default 16 if X86_NUMAQ || IA64
	default 15 if SMP
	default 14
	help
	  Select kernel log buffer size as a power of 2.
	  Defaults and Examples:
	  	     17 => 128 KB for S/390
		     16 => 64 KB for x86 NUMAQ or IA-64
	             15 => 32 KB for SMP
	             14 => 16 KB for uniprocessor
		     13 =>  8 KB
		     12 =>  4 KB

config DETECT_SOFTLOCKUP
	bool "Detect Soft Lockups"
	depends on DEBUG_KERNEL
	default y
	help
	  Say Y here to enable the kernel to detect "soft lockups",
	  which are bugs that cause the kernel to loop in kernel
	  mode for more than 10 seconds, without giving other tasks a
	  chance to run.

	  When a soft-lockup is detected, the kernel will print the
	  current stack trace (which you should report), but the
	  system will stay locked up. This feature has negligible
	  overhead.

	  (Note that "hard lockups" are separate type of bugs that
	   can be detected via the NMI-watchdog, on platforms that
	   support it.)

config SCHEDSTATS
	bool "Collect scheduler statistics"
	depends on DEBUG_KERNEL && PROC_FS
	help
	  If you say Y here, additional code will be inserted into the
	  scheduler and related routines to collect statistics about
	  scheduler behavior and provide them in /proc/schedstat.  These
	  stats may be useful for both tuning and debugging the scheduler
	  If you aren't debugging the scheduler or trying to tune a specific
	  application, you can say N to avoid the very slight overhead
	  this adds.

config DEBUG_SLAB
	bool "Debug memory allocations"
	depends on DEBUG_KERNEL
	help
	  Say Y here to have the kernel do limited verification on memory
	  allocation as well as poisoning memory on free to catch use of freed
	  memory. This can make kmalloc/kfree-intensive workloads much slower.

config DEBUG_PREEMPT
	bool "Debug preemptible kernel"
	depends on DEBUG_KERNEL && PREEMPT
	default y
	help
	  If you say Y here then the kernel will use a debug variant of the
	  commonly used smp_processor_id() function and will print warnings
	  if kernel code uses it in a preemption-unsafe way. Also, the kernel
	  will detect preemption count underflows.

config DEBUG_SPINLOCK
	bool "Spinlock debugging"
	depends on DEBUG_KERNEL
	help
	  Say Y here and build SMP to catch missing spinlock initialization
	  and certain other kinds of spinlock errors commonly made.  This is
	  best used in conjunction with the NMI watchdog so that spinlock
	  deadlocks are also debuggable.

config DEBUG_SPINLOCK_SLEEP
	bool "Sleep-inside-spinlock checking"
	depends on DEBUG_KERNEL
	help
	  If you say Y here, various routines which may sleep will become very
	  noisy if they are called with a spinlock held.

config DEBUG_KOBJECT
	bool "kobject debugging"
	depends on DEBUG_KERNEL
	help
	  If you say Y here, some extra kobject debugging messages will be sent
	  to the syslog. 

config DEBUG_HIGHMEM
	bool "Highmem debugging"
	depends on DEBUG_KERNEL && HIGHMEM
	help
	  This options enables addition error checking for high memory systems.
	  Disable for production systems.

config DEBUG_BUGVERBOSE
	bool "Verbose BUG() reporting (adds 70K)" if DEBUG_KERNEL && EMBEDDED
	depends on BUG
	depends on ARM || ARM26 || M32R || M68K || SPARC32 || SPARC64 || (X86 && !X86_64) || FRV
	default !EMBEDDED
	help
	  Say Y here to make BUG() panics output the file name and line number
	  of the BUG call as well as the EIP and oops trace.  This aids
	  debugging but costs about 70-100K of memory.

config DEBUG_INFO
	bool "Compile the kernel with debug info"
	depends on DEBUG_KERNEL
	default y if KGDB
	help
          If you say Y here the resulting kernel image will include
	  debugging info resulting in a larger kernel image.
	  Say Y here only if you plan to debug the kernel.

	  If unsure, say N.

config DEBUG_IOREMAP
	bool "Enable ioremap() debugging"
	depends on DEBUG_KERNEL && PARISC
	help
	  Enabling this option will cause the kernel to distinguish between
	  ioremapped and physical addresses.  It will print a backtrace (at
	  most one every 10 seconds), hopefully allowing you to see which
	  drivers need work.  Fixing all these problems is a prerequisite
	  for turning on USE_HPPA_IOREMAP.  The warnings are harmless;
	  the kernel has enough information to fix the broken drivers
	  automatically, but we'd like to make it more efficient by not
	  having to do that.

config DEBUG_FS
	bool "Debug Filesystem"
	depends on DEBUG_KERNEL && SYSFS
	help
	  debugfs is a virtual file system that kernel developers use to put
	  debugging files into.  Enable this option to be able to read and
	  write to these files.

	  If unsure, say N.

config FRAME_POINTER
	bool "Compile the kernel with frame pointers"
	depends on DEBUG_KERNEL && (X86 || CRIS || M68K || M68KNOMMU || FRV || UML || SUPERH)
	default y if DEBUG_INFO && UML
	default y if KGDB
	help
	  If you say Y here the resulting kernel image will be slightly larger
	  and slower, but it might give very useful debugging information
	  on some architectures or you use external debuggers.
	  If you don't debug the kernel, you can say N.

config WANT_EXTRA_DEBUG_INFORMATION
	bool
	select DEBUG_INFO
	select FRAME_POINTER if X86 || SUPERH
	default n

config KGDB
	bool "KGDB: kernel debugging with remote gdb"
	select WANT_EXTRA_DEBUG_INFORMATION
	depends on DEBUG_KERNEL && (ARM || X86 || MIPS || (SUPERH && !SUPERH64) || IA64 || X86_64 || PPC || PPC64)
	help
	  If you say Y here, it will be possible to remotely debug the
	  kernel using gdb. It is strongly suggested that you enable
	  DEBUG_INFO, and if available on your platform, FRAME_POINTER.
	  Documentation of kernel debugger available at
	  http://kgdb.sourceforge.net as well as in DocBook form
	  in Documentation/DocBook/.  If unsure, say N.

config KGDB_CONSOLE
	bool "KGDB: Console messages through gdb"
	depends on KGDB
	  help
	    If you say Y here, console messages will appear through gdb.
	    Other consoles such as tty or ttyS will continue to work as usual.
	    Note, that if you use this in conjunction with KGDB_ETH, if the
	    ethernet driver runs into an error condition during use with KGDB
	    it is possible to hit an infinite recusrion, causing the kernel
	    to crash, and typically reboot.  For this reason, it is preferable
	    to use NETCONSOLE in conjunction with KGDB_ETH instead of
	    KGDB_CONSOLE.

choice
	prompt "Method for KGDB communication"
	depends on KGDB
	default KGDB_8250_NOMODULE
	default KGDB_MPSC if SERIAL_MPSC
	default KGDB_CPM_UART if (8xx || 8260)
	default KGDB_SIBYTE if SIBYTE_SB1xxx_SOC
	default KGDB_BRCM97XXX if MIPS_BRCM97XXX
	help
	  There are a number of different ways in which you can communicate
	  with KGDB.  The most common is via serial, with the 8250 driver
	  (should your hardware have an 8250, or ns1655x style uart).
	  Another option is to use the NETPOLL framework and UDP, should
	  your ethernet card support this.  Other options may exist.
	  You can elect to have one core I/O driver that is built into the
	  kernel for debugging as the kernel is booting, or using only
	  kernel modules.

config KGDB_ONLY_MODULES
	bool "KGDB: Use only kernel modules for I/O"
	depends on MODULES
	help
	  Use only kernel modules to configure KGDB I/O after the
	  kernel is booted.

config KGDB_8250_NOMODULE
	bool "KGDB: On generic serial port (8250)"
	select KGDB_8250
	help
	  Uses generic serial port (8250) to communicate with the host
	  GDB.  This is independent of the normal (SERIAL_8250) driver
	  for this chipset.

config KGDBOE_NOMODULE
	bool "KGDB: On ethernet - in kernel"
	select KGDBOE
	select NETPOLL
	select NETPOLL_TRAP
	select NETPOLL_RX
	help
	  Uses the NETPOLL API to communicate with the host GDB via UDP.
	  In order for this to work, the ethernet interface specified must
	  support the NETPOLL API, and this must be initialized at boot.
	  See the documentation for syntax.

config KGDB_MPSC
	bool "KGDB on MV64x60 MPSC"
	depends on SERIAL_MPSC
	help
	  Uses a Marvell GT64260B or MV64x60 Multi-Purpose Serial
	  Controller (MPSC) channel. Note that the GT64260A is not
	  supported.

config KGDB_CPM_UART
 	bool "KGDB: On CPM UART"
	depends on PPC && (CPM2 || 8xx)
 	help
 	  Uses CPM UART to communicate with the host GDB.

config KGDB_SIBYTE
	bool "KGDB: On the Broadcom SWARM serial port"
	depends on MIPS && SIBYTE_SB1xxx_SOC

config KGDB_BRCM97XXX
	bool "KGDB: On the Broadcom bcm97xxx serial port"
	depends on MIPS
	depends on MIPS_BRCM97XXX && KGDB
	help
	  Enables the KGDB serial driver for the Broadcom bcm97xxx boards
endchoice

choice
 	prompt "SCC/SMC for KGDB CPM UART console"
 	depends on KGDB_CPM_UART
 	default KGDB_CPM_UART_SCC4 if ADS8272

config KGDB_CPM_UART_SCC1
 	bool "Use SCC1 for KGDB"
 	depends on SERIAL_CPM_SCC1

config KGDB_CPM_UART_SCC2
 	bool "Use SCC2 for KGDB"
 	depends on SERIAL_CPM_SCC2

config KGDB_CPM_UART_SCC3
 	bool "Use SCC3 for KGDB"
 	depends on SERIAL_CPM_SCC3

config KGDB_CPM_UART_SCC4
 	bool "Use SCC4 for KGDB"
 	depends on SERIAL_CPM_SCC4

config KGDB_CPM_UART_SMC1
 	bool "Use SMC1 for KGDB"
 	depends on SERIAL_CPM_SMC1

config KGDB_CPM_UART_SMC2
 	bool "Use SMC2 for KGDB"
 	depends on SERIAL_CPM_SMC2

endchoice

config KGDBOE
	tristate "KGDB: On ethernet" if !KGDBOE_NOMODULE
	depends on m && KGDB
	select NETPOLL
	select NETPOLL_TRAP
	select NETPOLL_RX
	help
	  Uses the NETPOLL API to communicate with the host GDB via UDP.
	  In order for this to work, the ethernet interface specified must
	  support the NETPOLL API, and this must be initialized at boot.
	  See the documentation for syntax.

config KGDB_8250
	tristate "KGDB: On generic serial port (8250)" if !KGDB_8250_NOMODULE
	depends on m && KGDB_ONLY_MODULES
	help
	  Uses generic serial port (8250) to communicate with the host
	  GDB.  This is independent of the normal (SERIAL_8250) driver
	  for this chipset.

config KGDB_SIMPLE_SERIAL
	bool "Simple selection of KGDB serial port"
	depends on KGDB_8250_NOMODULE
	default y
	help
	  If you say Y here, you will only have to pick the baud rate
	  and port number that you wish to use for KGDB.  Note that this
	  only works on architectures that register known serial ports
	  early on.  If you say N, you will have to provide, either here
	  or on the command line, the type (I/O or MMIO), IRQ and
	  address to use.  If in doubt, say Y.

config KGDB_BAUDRATE
	int "Debug serial port baud rate"
	depends on (KGDB_8250 && KGDB_SIMPLE_SERIAL)
	default "115200"
	help
	  gdb and the kernel stub need to agree on the baud rate to be
	  used.  Standard rates from 9600 to 115200 are allowed, and this
	  may be overridden via the commandline.

config KGDB_PORT_NUM
	int "Serial port number for KGDB"
	range 0 1 if KGDB_MPSC
	range 0 3
	depends on (KGDB_8250 && KGDB_SIMPLE_SERIAL) || KGDB_MPSC
	default "1"
	help
	  Pick the port number (0 based) for KGDB to use.

config KGDB_8250_CONF_STRING
	string "Configuration string for KGDB"
	depends on KGDB_8250_NOMODULE && !KGDB_SIMPLE_SERIAL
	default "io,2f8,115200,3" if X86
	help
	  The format of this string should be <io or
	  mmio>,<address>,<baud rate>,<irq>.  For example, to use the
	  serial port on an i386 box located at 0x2f8 and 115200 baud
	  on IRQ 3 at use:
	  io,2f8,115200,3
```
