## init/Kconfig
```kconfig
menu "Code maturity level options"

config EXPERIMENTAL
	bool "Prompt for development and/or incomplete code/drivers"
	---help---
	  Some of the various things that Linux supports (such as network
	  drivers, file systems, network protocols, etc.) can be in a state
	  of development where the functionality, stability, or the level of
	  testing is not yet high enough for general use. This is usually
	  known as the "alpha-test" phase among developers. If a feature is
	  currently in alpha-test, then the developers usually discourage
	  uninformed widespread use of this feature by the general public to
	  avoid "Why doesn't this work?" type mail messages. However, active
	  testing and use of these systems is welcomed. Just be aware that it
	  may not meet the normal level of reliability or it may fail to work
	  in some special cases. Detailed bug reports from people familiar
	  with the kernel internals are usually welcomed by the developers
	  (before submitting bug reports, please read the documents
	  <file:README>, <file:MAINTAINERS>, <file:REPORTING-BUGS>,
	  <file:Documentation/BUG-HUNTING>, and
	  <file:Documentation/oops-tracing.txt> in the kernel source).

	  This option will also make obsoleted drivers available. These are
	  drivers that have been replaced by something else, and/or are
	  scheduled to be removed in a future kernel release.

	  Unless you intend to help test and develop a feature or driver that
	  falls into this category, or you have a situation that requires
	  using these features, you should probably say N here, which will
	  cause the configurator to present you with fewer choices. If
	  you say Y here, you will be offered the choice of using features or
	  drivers that are currently considered to be in the alpha-test phase.

config CLEAN_COMPILE
	bool "Select only drivers expected to compile cleanly" if EXPERIMENTAL
	default y
	help
	  Select this option if you don't even want to see the option
	  to configure known-broken drivers.

	  If unsure, say Y

config BROKEN
	bool
	depends on !CLEAN_COMPILE
	default y

config BROKEN_ON_SMP
	bool
	depends on BROKEN || !SMP
	default y

config LOCK_KERNEL
	bool
	depends on SMP || PREEMPT
	default y

config INIT_ENV_ARG_LIMIT
	int
	default 32 if !USERMODE
	default 128 if USERMODE
	help
	  This is the value of the two limits on the number of argument and of
	  env.var passed to init from the kernel command line.

endmenu

menu "General setup"

config LOCALVERSION
	string "Local version - append to kernel release"
	help
	  Append an extra string to the end of your kernel version.
	  This will show up when you type uname, for example.
	  The string you set here will be appended after the contents of
	  any files with a filename matching localversion* in your
	  object and source tree, in that order.  Your total string can
	  be a maximum of 64 characters.

config LOCALVERSION_AUTO
	bool "Automatically append version information to the version string"
	default y
	help
	  This will try to automatically determine if the current tree is a
	  release tree by looking for git tags that
	  belong to the current top of tree revision.

	  A string of the format -gxxxxxxxx will be added to the localversion
	  if a git based tree is found.  The string generated by this will be
	  appended after any matching localversion* files, and after the value
	  set in CONFIG_LOCALVERSION

	  Note: This requires Perl, and a git repository, but not necessarily
	  the git or cogito tools to be installed.

config SWAP
	bool "Support for paging of anonymous memory (swap)"
	depends on MMU
	default y
	help
	  This option allows you to choose whether you want to have support
	  for socalled swap devices or swap files in your kernel that are
	  used to provide more virtual memory than the actual RAM present
	  in your computer.  If unsure say Y.

config SYSVIPC
	bool "System V IPC"
	depends on MMU
	---help---
	  Inter Process Communication is a suite of library functions and
	  system calls which let processes (running programs) synchronize and
	  exchange information. It is generally considered to be a good thing,
	  and some programs won't run unless you say Y here. In particular, if
	  you want to run the DOS emulator dosemu under Linux (read the
	  DOSEMU-HOWTO, available from <http://www.tldp.org/docs.html#howto>),
	  you'll need to say Y here.

	  You can find documentation about IPC with "info ipc" and also in
	  section 6.4 of the Linux Programmer's Guide, available from
	  <http://www.tldp.org/guides.html>.

config POSIX_MQUEUE
	bool "POSIX Message Queues"
	depends on NET && EXPERIMENTAL
	---help---
	  POSIX variant of message queues is a part of IPC. In POSIX message
	  queues every message has a priority which decides about succession
	  of receiving it by a process. If you want to compile and run
	  programs written e.g. for Solaris with use of its POSIX message
	  queues (functions mq_*) say Y here. To use this feature you will
	  also need mqueue library, available from
	  <http://www.mat.uni.torun.pl/~wrona/posix_ipc/>

	  POSIX message queues are visible as a filesystem called 'mqueue'
	  and can be mounted somewhere if you want to do filesystem
	  operations on message queues.

	  If unsure, say Y.

config BSD_PROCESS_ACCT
	bool "BSD Process Accounting"
	help
	  If you say Y here, a user level program will be able to instruct the
	  kernel (via a special system call) to write process accounting
	  information to a file: whenever a process exits, information about
	  that process will be appended to the file by the kernel.  The
	  information includes things such as creation time, owning user,
	  command name, memory usage, controlling terminal etc. (the complete
	  list is in the struct acct in <file:include/linux/acct.h>).  It is
	  up to the user level program to do useful things with this
	  information.  This is generally a good idea, so say Y.

config BSD_PROCESS_ACCT_V3
	bool "BSD Process Accounting version 3 file format"
	depends on BSD_PROCESS_ACCT
	default n
	help
	  If you say Y here, the process accounting information is written
	  in a new file format that also logs the process IDs of each
	  process and it's parent. Note that this file format is incompatible
	  with previous v0/v1/v2 file formats, so you will need updated tools
	  for processing it. A preliminary version of these tools is available
	  at <http://www.physik3.uni-rostock.de/tim/kernel/utils/acct/>.

config SYSCTL
	bool "Sysctl support"
	---help---
	  The sysctl interface provides a means of dynamically changing
	  certain kernel parameters and variables on the fly without requiring
	  a recompile of the kernel or reboot of the system.  The primary
	  interface consists of a system call, but if you say Y to "/proc
	  file system support", a tree of modifiable sysctl entries will be
	  generated beneath the /proc/sys directory. They are explained in the
	  files in <file:Documentation/sysctl/>.  Note that enabling this
	  option will enlarge the kernel by at least 8 KB.

	  As it is generally a good thing, you should say Y here unless
	  building a kernel for install/rescue disks or your system is very
	  limited in memory.

config AUDIT
	bool "Auditing support"
	depends on NET
	default y if SECURITY_SELINUX
	help
	  Enable auditing infrastructure that can be used with another
	  kernel subsystem, such as SELinux (which requires this for
	  logging of avc messages output).  Does not do system-call
	  auditing without CONFIG_AUDITSYSCALL.

config AUDITSYSCALL
	bool "Enable system-call auditing support"
	depends on AUDIT && (X86 || PPC || PPC64 || ARCH_S390 || IA64 || UML || SPARC64)
	default y if SECURITY_SELINUX
	help
	  Enable low-overhead system-call auditing infrastructure that
	  can be used independently or with another kernel subsystem,
	  such as SELinux.

config HOTPLUG
	bool "Support for hot-pluggable devices" if !ARCH_S390
	default ARCH_S390
	help
	  This option is provided for the case where no in-kernel-tree
	  modules require HOTPLUG functionality, but a module built
	  outside the kernel tree does. Such modules require Y here.

config KOBJECT_UEVENT
	bool "Kernel Userspace Events"
	depends on NET
	default y
	help
	  This option enables the kernel userspace event layer, which is a
	  simple mechanism for kernel-to-user communication over a netlink
	  socket.
	  The goal of the kernel userspace events layer is to provide a simple
	  and efficient events system, that notifies userspace about kobject
	  state changes. This will enable applications to just listen for
	  events instead of polling system devices and files.
	  Hotplug events (kobject addition and removal) are also available on
	  the netlink socket in addition to the execution of /sbin/hotplug if
	  CONFIG_HOTPLUG is enabled.

	  Say Y, unless you are building a system requiring minimal memory
	  consumption.

config IKCONFIG
	bool "Kernel .config support"
	---help---
	  This option enables the complete Linux kernel ".config" file
	  contents to be saved in the kernel. It provides documentation
	  of which kernel options are used in a running kernel or in an
	  on-disk kernel.  This information can be extracted from the kernel
	  image file with the script scripts/extract-ikconfig and used as
	  input to rebuild the current kernel or to build another kernel.
	  It can also be extracted from a running kernel by reading
	  /proc/config.gz if enabled (below).

config IKCONFIG_PROC
	bool "Enable access to .config through /proc/config.gz"
	depends on IKCONFIG && PROC_FS
	---help---
	  This option enables access to the kernel configuration file
	  through /proc/config.gz.

config CPUSETS
	bool "Cpuset support"
	depends on SMP
	help
	  This option will let you create and manage CPUSETs which
	  allow dynamically partitioning a system into sets of CPUs and
	  Memory Nodes and assigning tasks to run only within those sets.
	  This is primarily useful on large SMP or NUMA systems.

	  Say N if unsure.

source "usr/Kconfig"

menuconfig EMBEDDED
	bool "Configure standard kernel features (for small systems)"
	help
	  This option allows certain base kernel options and settings
          to be disabled or tweaked. This is for specialized
          environments which can tolerate a "non-standard" kernel.
          Only use this if you really know what you are doing.

config KALLSYMS
	 bool "Load all symbols for debugging/kksymoops" if EMBEDDED
	 default y
	 help
	   Say Y here to let the kernel print out symbolic crash information and
	   symbolic stack backtraces. This increases the size of the kernel
	   somewhat, as all symbols have to be loaded into the kernel image.

config KALLSYMS_ALL
	bool "Include all symbols in kallsyms"
	depends on DEBUG_KERNEL && KALLSYMS
	help
	   Normally kallsyms only contains the symbols of functions, for nicer
	   OOPS messages.  Some debuggers can use kallsyms for other
	   symbols too: say Y here to include all symbols, if you need them 
	   and you don't care about adding 300k to the size of your kernel.

	   Say N.

config KALLSYMS_EXTRA_PASS
	bool "Do an extra kallsyms pass"
	depends on KALLSYMS
	help
	   If kallsyms is not working correctly, the build will fail with
	   inconsistent kallsyms data.  If that occurs, log a bug report and
	   turn on KALLSYMS_EXTRA_PASS which should result in a stable build.
	   Always say N here unless you find a bug in kallsyms, which must be
	   reported.  KALLSYMS_EXTRA_PASS is only a temporary workaround while
	   you wait for kallsyms to be fixed.


config PRINTK
	default y
	bool "Enable support for printk" if EMBEDDED
	help
	  This option enables normal printk support. Removing it
	  eliminates most of the message strings from the kernel image
	  and makes the kernel more or less silent. As this makes it
	  very difficult to diagnose system problems, saying N here is
	  strongly discouraged.

config BUG
	bool "BUG() support" if EMBEDDED
	default y
	help
          Disabling this option eliminates support for BUG and WARN, reducing
          the size of your kernel image and potentially quietly ignoring
          numerous fatal conditions. You should only consider disabling this
          option for embedded systems with no facilities for reporting errors.
          Just say Y.

config KMALLOC_ACCOUNTING
	default n
	bool "Enabled accounting of kmalloc/kfree allocations" if EMBEDDED
	help
	  This option records kmalloc and kfree activity and reports it via
	  /proc/kmalloc.

config AUDIT_BOOTMEM
	default n
	bool "Enabled auditing of bootmem allocations" if EMBEDDED
	help
	  This option causes the bootmem allocator to print caller and size
          for each allocation.

config DOUBLEFAULT
	depends X86
	default y if X86
	bool "Enable doublefault exception handler" if EMBEDDED
	help
          This option allows trapping of rare doublefault exceptions that
          would otherwise cause a system to silently reboot. Disabling this
          option saves about 4k.

config PANIC
	default y
	bool "Enable panic reporting code" if EMBEDDED
	help
	  Disabling this completely removes panic handling code.
          Warning: this can result in data loss if a panic condition
          occurs, as the kernel may ignore the condition entirely.

config FULL_PANIC
        depends PANIC
	default y
	bool "Full panic reporting data" if EMBEDDED
	help
	  This includes text descriptions of panics in addition to stack dumps.
          Disabling compiles out the explanations for panics, saving
	  string space. Use with caution.

config ELF_CORE
	default y
	bool "Enable ELF core dumps" if EMBEDDED
	help
	  Enable support for generating core dumps. Disabling saves about 4k.

config BASE_FULL
	default y
	bool "Enable full-sized data structures for core" if EMBEDDED
	help
	  Disabling this option reduces the size of miscellaneous core
	  kernel data structures. This saves memory on small machines,
	  but may reduce performance.

config NET_SMALL
	default n
	bool "Enable various size reductions for networking" if EMBEDDED
	help
	  This reduces the size of miscellaneous networking data structures.
          Currently a placeholder.

config FUTEX
	bool "Enable futex support" if EMBEDDED
	default y
	help
	  Disabling this option will cause the kernel to be built without
	  support for "fast userspace mutexes".  The resulting kernel may not
	  run glibc-based applications correctly.

config EPOLL
	bool "Enable eventpoll support" if EMBEDDED
	default y
	help
	  Disabling this option will cause the kernel to be built without
	  support for epoll family of system calls.

config VM86
	depends X86
	default y
	bool "Enable VM86 support" if EMBEDDED
	help
          This option is required by programs like DOSEMU to run 16-bit legacy
	  code on X86 processors. It also may be needed by software like
          XFree86 to initialize some video cards via BIOS. Disabling this
          option saves about 6k.

config AIO
	default y
	bool "Enable AIO support" if EMBEDDED
	help
	  This option enables POSIX async IO which may be used by some high
	  performance threaded applications. Disabling this option saves about
	  5k.

config SYSENTER
	depends X86
	default y
	bool "Enable syscalls via sysenter" if EMBEDDED
	help
	  Disabling this feature removes sysenter handling as well as
	  vsyscall fixmaps.
 
config XATTR
	default y
	bool "Enable filesystem extended attribute support" if EMBEDDED
	help
	  This enables the filesystem extended attribute syscalls.

config FILE_LOCKING
	default y
	bool "Enable POSIX file locking API" if EMBEDDED
	help
	  This enables standard file locking support.

config ETHTOOL
	depends NET
	default y
	bool "Enable ethtool support" if EMBEDDED
	help
	  Disabling this option removes support for configuring
	  ethernet device features via ethtool. Saves about 6k.

config INETPEER
	default y
	bool "Enable INET peer information storage" if EMBEDDED
	help
	  This allows storing various information about network peers.
	  Disabling saves about 2k.

config NET_SK_FILTER
        default y
	depends NET
	bool "Enable network socket filter" if EMBEDDED
	help
	  This enables the basic kernel level socket filtering, not to
	  be confused with netfilter. Required by PPP.

config NET_DEV_MULTICAST
	default y
	depends NET
	bool "Enable device multicast support" if EMBEDDED
	help
	  This enables the core device multicast list management code.

config IGMP
	depends NET
	default y
	bool "Enable IGMP support" if EMBEDDED && !IP_MULTICAST
	help
	  This includes support for the Internet group management
	  protocol, used for multicast.

config MEASURE_INLINES
	default n
	bool "Enable inline measurement" if EMBEDDED
	help
          This marks inline functions deprecated, causing a kernel compile
          to spew information about the location of each compilation.
          With some post-processing, this can be used to generate counts
          and footprints. Say N unless you want a very noisy build.

config CC_OPTIMIZE_FOR_SIZE
	bool "Optimize for size" if EMBEDDED
	default y if ARM || H8300
	help
	  Enabling this option will pass "-Os" instead of "-O2" to gcc
	  resulting in a smaller kernel.

	  WARNING: some versions of gcc may generate incorrect code with this
	  option.  If problems are observed, a gcc upgrade may be needed.

	  If unsure, say N.

config SHMEM
	bool "Use full shmem filesystem" if EMBEDDED
	default y
	depends on MMU
	help
	  The shmem is an internal filesystem used to manage shared memory.
	  It is backed by swap and manages resource limits. It is also exported
	  to userspace as tmpfs if TMPFS is enabled. Disabling this
	  option replaces shmem and tmpfs with the much simpler ramfs code,
	  which may be appropriate on small systems without swap.

config CC_ALIGN_FUNCTIONS
	int "Function alignment" if EMBEDDED
	default 0
	help
	  Align the start of functions to the next power-of-two greater than n,
	  skipping up to n bytes.  For instance, 32 aligns functions
	  to the next 32-byte boundary, but 24 would align to the next
	  32-byte boundary only if this can be done by skipping 23 bytes or less.
	  Zero means use compiler's default.

config CC_ALIGN_LABELS
	int "Label alignment" if EMBEDDED
	default 0
	help
	  Align all branch targets to a power-of-two boundary, skipping
	  up to n bytes like ALIGN_FUNCTIONS.  This option can easily
	  make code slower, because it must insert dummy operations for
	  when the branch target is reached in the usual flow of the code.
	  Zero means use compiler's default.

config CC_ALIGN_LOOPS
	int "Loop alignment" if EMBEDDED
	default 0
	help
	  Align loops to a power-of-two boundary, skipping up to n bytes.
	  Zero means use compiler's default.

config CC_ALIGN_JUMPS
	int "Jump alignment" if EMBEDDED
	default 0
	help
	  Align branch targets to a power-of-two boundary, for branch
	  targets where the targets can only be reached by jumping,
	  skipping up to n bytes like ALIGN_FUNCTIONS.  In this case,
	  no dummy operations need be executed.
	  Zero means use compiler's default.

config NEST_ALTSTACK
	bool "Enable nested sigaltstack manipulations"
	default n
	help
	  Enabling this will allow apps to call sigaltstack from a signal
	  handler already running with an alternate stack.  To enable nested
	  sigaltstack calls, specify SS_ALLOW_NESTED in addition to whatever
	  flags you were going to use in the "ss" parameter to the sigaltstack()
	  syscall.

config OOM_PROTECT
	bool "OOM killer protection"
	default n
	help
	  When enabled this adds a new capability to the kernel which
	  may be called (by processes with appropriate priviledges) to
	  request protection from the out-of-memory killer as long as
	  the process is using less than the specified amount of virtual
	  memory.  This is accomplished through a call to setrlimit().

config TINY_CFLAGS
	default n
	bool "Set compiler arch flags for small 386 code" if EMBEDDED
	help
	  This allows user to replace the architecture CFLAGS despite the arch
	  setting in an attempt to build smaller code.

config TINY_CFLAGS_VAL
	depends TINY_CFLAGS
	default "-march=i386"
	string "Arch CFLAGS"
	help
	  Enter CFLAGS to override ARCH defaults.

config CRC32_TABLES
	depends CRC32
	default y
	bool "Calculate CRC32 with tables" if EMBEDDED
	help
	  This option enables use of tables for CRC calculation. Disabling
          reduces kernel size by about 2K. This may actually result in
          faster code on machines with limited memory bandwidth.

config INLINE_THREADINFO
	depends X86
	default y
	bool "Inline current pointer calculation" if EMBEDDED && !SMP
	help
	  Disabling this simplifies the code for finding information
          about the current thread. Saves about 4k on small kernels.

config SLAB
	default y
	bool "Use full SLAB allocator" if EMBEDDED
	help
	  Disabling this replaces the advanced SLAB allocator and
	  kmalloc support with the drastically simpler SLOB allocator.
	  SLOB is more space efficient but does not scale well and is
	  more susceptible to fragmentation.

config MEMPOOL
	default y
	bool "Use mempool allocator" if EMBEDDED
	help
	  The mempool allocator attempts keep a reserve pool of
	  various objects available for use in low-memory situations.
	  Disabling this feature may make more memory available and
	  will somewhat decrease code size, but with a higher risk of
	  deadlock under some loads.

config CONSOLE_TRANSLATIONS
	default y
	bool "Enable character translations in console" if EMBEDDED
	help
	  This enables support for font mapping and Unicode translation
          on virtual consoles.

config BINFMT_SCRIPT
	default y
	bool "Enable support for executable shell scripts" if EMBEDDED
	help
	  Enable support for standard #!-style shell scripts.

config BINFMT_ELF_AOUT
	bool "ELF binaries with a.out linkage" if EMBEDDED
	depends on BINFMT_ELF
	default BINFMT_AOUT
	help
	  The kernel may support ELF executables which use an a.out format
	  interpreter (dynamic linker) and/or a.out shared libraries, in
	  addition to the usual ELF-ELF setups. You shouldn't need this.

config MAX_SWAPFILES_SHIFT
	int "Number of swap files log2 (0 => 1, 5 => 32)" if EMBEDDED
	range 0 5
	default 5
	help
	  Select the maximum number of swapfiles (5 for default).

config NR_LDISCS
	int "Number of tty line disciplines" if EMBEDDED
	range 0 16
	default 16
	help
	  Select the maximum number of tty line disciplines. Embedded systems
          can probably get by with only a few of these.

config MAX_USER_RT_PRIO
	int "Number of realtime priority levels" if EMBEDDED
	range 5 100
	default 100
	help
	  This option allows reducing the size of the O(1) scheduler arrays.

config IDE_HWIFS
	depends IDE
	int "Number of IDE hardware interfaces (0 for default)" if EMBEDDED
	range 0 20
	default 0
	help
	  Select the maximum number of IDE interfaces (0 for default).
          Saves up to 14k.

config BOOTFLAG
	depends X86
	default y
	bool "Enable Simple Bootflag" if EMBEDDED
	help
	  This enables support for the Simple Bootflag Specification.

config SERIAL_PCI
	depends PCI && SERIAL_8250
	default y
	bool "Enable standard PCI serial support" if EMBEDDED
	help
	  This builds standard PCI serial support. You may be able to disable
          this feature if you are only need legacy serial support.
	  Saves about 9K.

config DMI_SCAN
	depends X86
	default y
	bool "Enabled DMI scanning" if EMBEDDED
	help
          Enabled scanning of DMI to identify machine quirks. Say Y
          here unless you have verified that your setup is not
          affected by entries in the DMI blacklist. Required by PNP
          BIOS code. Disabling scanning saves about 5k of
          initialization code.

config PCI_QUIRKS
	default y
	bool "Enable PCI quirk workarounds" if EMBEDDED
	help
	  This enables workarounds for various PCI chipset bugs/quirks.
	  Disable this only if you know your target machine is unaffected
	  by PCI quirks.

config X86_TSC_TIMER
	depends X86
	default y
	bool "Enable TSC timer" if EMBEDDED
	help
	  This enables support for the Time Stamp Counter timer.

menuconfig PROCESSOR_SELECT
	depends X86
	default y
	bool "Supported processor vendors" if EMBEDDED
	help
	  This lets you choose what x86 vendor support code your kernel
	  will include.

config CPU_SUP_INTEL
       default y
       bool "Support Intel processors" if PROCESSOR_SELECT
       help
         This enables extended support for Intel processors

config CPU_SUP_CYRIX
       default y
       bool "Support Cyrix processors" if PROCESSOR_SELECT
       help
         This enables extended support for Cyrix processors

config CPU_SUP_NSC
       default y
       bool "Support NSC processors" if PROCESSOR_SELECT
       help
         This enables extended support for NSC processors

config CPU_SUP_AMD
       default y
       bool "Support AMD processors" if PROCESSOR_SELECT
       help
         This enables extended support for AMD processors

config CPU_SUP_CENTAUR
       default y
       bool "Support Centaur processors" if PROCESSOR_SELECT
       help
         This enables extended support for Centaur processors

config CPU_SUP_TRANSMETA
       default y
       bool "Support Transmeta processors" if PROCESSOR_SELECT
       help
         This enables extended support for Transmeta processors

config CPU_SUP_RISE
       default y
       bool "Support Rise processors" if PROCESSOR_SELECT
       help
         This enables extended support for Rise processors

config CPU_SUP_NEXGEN
       default y
       bool "Support NexGen processors" if PROCESSOR_SELECT
       help
         This enables extended support for NexGen processors

config CPU_SUP_UMC
       default y
       bool "Support UMC processors" if PROCESSOR_SELECT
       help
         This enables extended support for UMC processors

endmenu		# General setup

config CRC32_CALC
	default !CRC32_TABLES
	bool

config TINY_SHMEM
	default !SHMEM
	bool

config BASE_SMALL
	int
	default 0 if BASE_FULL
	default 1 if !BASE_FULL

config SLOB
	default !SLAB
	bool
```
