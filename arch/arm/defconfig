## arch/normal/Kconfig
```kconfig
#############################################################################
#
# For a description of the syntax of this configuration file,
# see Documentation/kbuild/kconfig-language.txt.
#
#############################################################################

mainmenu "uClinux/v850 (w/o MMU) Kernel Configuration"

config MMU
       	bool
	default n
config UID16
	bool
	default n
config RWSEM_GENERIC_SPINLOCK
	bool
	default y
config RWSEM_XCHGADD_ALGORITHM
	bool
	default n
config GENERIC_CALIBRATE_DELAY
	bool
	default y

# Turn off some random 386 crap that can affect device config
config ISA
	bool
	default n
config ISAPNP
	bool
	default n
config EISA
	bool
	default n
config MCA
	bool
	default n


source "mm/Kconfig"

#############################################################################

source init/Kconfig

#############################################################################

menu "Bus options (PCI, PCMCIA, EISA, MCA, ISA)"

#    config PCI
# 	   bool "PCI support"
# 	   help
# 	     Support for PCI bus.

source "drivers/pci/Kconfig"

source "drivers/pcmcia/Kconfig"

source "drivers/pci/hotplug/Kconfig"

endmenu

menu "Executable file formats"

source "fs/Kconfig.binfmt"

endmenu

source "net/Kconfig"

#############################################################################

source "drivers/base/Kconfig"

source drivers/mtd/Kconfig

source drivers/parport/Kconfig

#source drivers/pnp/Kconfig

source drivers/block/Kconfig

#############################################################################

menu "Disk device support"

source "drivers/ide/Kconfig"

source "drivers/scsi/Kconfig"

endmenu

#############################################################################


source "drivers/md/Kconfig"

source "drivers/message/fusion/Kconfig"

source "drivers/ieee1394/Kconfig"

source "drivers/message/i2o/Kconfig"

source "drivers/net/Kconfig"

source "drivers/isdn/Kconfig"

#source "drivers/telephony/Kconfig"

#
# input before char - char/joystick depends on it. As does USB.
#
source "drivers/input/Kconfig"

source "drivers/char/Kconfig"

#source drivers/misc/Config.in
source "drivers/media/Kconfig"

source "fs/Kconfig"

source "drivers/video/Kconfig"

source "sound/Kconfig"

source "drivers/usb/Kconfig"

source "arch/v850/Kconfig.debug"

source "security/Kconfig"

source "crypto/Kconfig"

source "lib/Kconfig"

#############################################################################
```

## arch/ppc/platforms/85xx/Kconfig
```kconfig
config 85xx
	bool
	depends on E500
	default y

config PPC_INDIRECT_PCI_BE
	bool
	depends on 85xx
	default y

menu "Freescale 85xx options"
	depends on E500

choice
	prompt "Machine Type"
	depends on 85xx
	default MPC8540_ADS

config MPC8540_ADS
	bool "Freescale MPC8540 ADS"
	help
	  This option enables support for the MPC 8540 ADS evaluation board.

config MPC8548_CDS
	bool "Freescale MPC8548 CDS"
	help
	  This option enables support for the MPC8548 CDS evaluation board.

config ARCADIA_X3
	bool "Arcadia X3 Board"
	depends on MPC8548_CDS
	default y

config MPC8555_CDS
	bool "Freescale MPC8555 CDS"
	help
	  This option enables support for the MPC8555 CDS evaluation board.

config MPC8560_ADS
	bool "Freescale MPC8560 ADS"
	help
	  This option enables support for the MPC 8560 ADS evaluation board.

config GDA_G8500
	bool "GDA RMC-G8500"
	help
	  This option enables support for the GDA RMC-G8500 MPC8540 evaluation board.

config MPC8540_EVAL
        bool "Freescale MPC8540 EVAL"
        help
          This option enables support for the MPC8540EVAL board.

config SBC8560
	bool "WindRiver PowerQUICC III SBC8560"
	help
	  This option enables support for the WindRiver PowerQUICC III 
	  SBC8560 board.

config STX_GP3
	bool "Silicon Turnkey Express GP3"
	help
	  This option enables support for the Silicon Turnkey Express GP3
	  board.

endchoice

# It's often necessary to know the specific 85xx processor type.
# Fortunately, it is implied (so far) from the board type, so we
# don't need to ask more redundant questions.
config MPC8540
	bool
	depends on MPC8540_EVAL || MPC8540_ADS || GDA_G8500
	default y

config MPC8548
	bool
	depends on MPC8548_CDS
	default y

config MPC854x
	bool
	depends on MPC8540 || MPC8548
	default y

config MPC8555
	bool
	depends on MPC8555_CDS
	default y

config MPC8560
	bool
	depends on SBC8560 || MPC8560_ADS || STX_GP3
	default y

config 85xx_PCI2
	bool "Support for 2nd PCI host controller"
	depends on MPC8555_CDS
	default y

config PEX
	bool "PCI Express support"
	depends on PCI && MPC8548 && ARCADIA_X3
	help
	  !!!!!!!!!! WARNING !!!!!!!!!!
	  Enables Support for PCI Express
	  This requires hardware modification to work correctly if your CPU version < 2.0.
	  and will BREAK the PCI bus
	  Please contact Freescale for details
	  Thank You 
	  !!!!!!!!!! WARNING !!!!!!!!!!

config PPC_GEN550
	bool
	depends on MPC8540 || SBC8560 || MPC8555
	default y

endmenu
```

## arch/trimedia/Kconfig
```kconfig
#
# For a description of the syntax of this configuration file,
# see Documentation/kbuild/kconfig-language.txt.
#

mainmenu "TriMedia Kernel Configuration"

config  TRIMEDIA
	bool
	default y

config MMU
	bool
	default n

config FPU
	bool
	default n

config UID16
	bool
	default y

config RWSEM_GENERIC_SPINLOCK
	bool
	default y

config RWSEM_XCHGADD_ALGORITHM
	bool
	default n

config GENERIC_CALIBRATE_DELAY
	bool
	default y

config KTIME_SCALAR
	bool
	default y

config SEMAPHORE_SLEEPERS
	bool
	default y

config GENERIC_HARDIRQS
	bool
	default y

source "init/Kconfig"

menu "Processor type and features"

#
# TriMedia Host type: tmsim ttisim winnt nohost
#
config  OLD_TMSIM
	bool 
	default n

config  TTISIM 
	bool 
	default n

config  WINNT 
	bool
	default n

config  NOHOST
	bool
	default n

#
# TriMedia target type: tm1300 pnx1500 pnx1700 pnx1005
#
config  TM1300
	bool
	default n

config  PNX1500
	bool
	default n

config  PNX1700
	bool
	default n

config  PNX1005
	bool
	default n

choice 
	prompt "Target Board"
	default SIM1500 

config SIM1300
	bool "TM1300 simulator"
	select OLD_TMSIM 
	select TM1300 
	help
	  trimedia simulator based on Philips semiconductor's TM1300 processor 
	  providered in Philips/NXP TCS.

config SIM1500
	bool "PNX1500 simulator"
	select TTISIM
	select PNX1500
	help
	  trimedia simulator based on NXP PNX1500 providered in NXP TCS.

config SIM1700
	bool "PNX1700 simulator"
	select TTISIM
	select PNX1700
	help
	  trimedia simulator based on NXP PNX1700 providered in NXP TCS.

config SIM1005
	bool "PNX1005 simulator"
	select TTISIM
	select PNX1005
	help
	  trimedia simulator based on NXP PNX1005 providered in NXP TCS.

config MBE1500
	bool "MDS MBE-1500"
	select NOHOST
	select PNX1500
	help
	  A modular PICMG-based Development System for Stand-alone Portable Media Player 
	  Devices based on NXP PNX1500 Nexperia Digital Media Processors produced by MDS (www.mds.com)

config  LCP1500 
	bool "MDS LCP-1500"
	select WINNT
	select PNX1500
	help
	  A PCI Plug-in Development Cards for PNX1500 Nexperia Digital Media Processors 
	  produced by MDS(www.mds.com)

endchoice

choice  
	prompt "Byte order"
	default LITTLE_ENDIAN

config  LITTLE_ENDIAN
	bool "Little endian"
	help
	  Little endian

config  BIG_ENDIAN
	bool "Big endian"
	help
	  Big endian

endchoice

choice
	prompt "Float point bits"
	default FP32

config  FP32
	bool "32 bits"
	help
	  32 bits float point support.

config  FP64
	bool "64 bits"
	help
	  64 bits float point emulation support.

endchoice

#
# FIXME: I don't like it and will remove it assa.
#
choice 
	prompt "Build Type variables"
	default TMTGTREL_ASSERT

config TMTGTREL_RETIAL
	bool "retial"

config TMTGTREL_ASSERT
	bool "assert"

config TMTGTREL_TRACE
	bool "trace"

config TMTGTREL_DEBUG
	bool "debug"

endchoice

config TMJTAGMON
	bool "TriMedia Jtag monitor support"
	depends on NOHOST
	default n
	help
	  Enable the jtag monitor support for standalone board. 

config TMDBG_BUF_SIZE
	int "Buffer size for trimedia debug mechanism(Kbytes)"
	depends on !TMTGTREL_RETIAL
	range 4 10
	default 4
	help
	  Buffer size for trimedia debug mechanism (Kbytes)

config  4KSTACKS
	bool "Each Task has 4K kernel stack"
	default n
	help
	  Enable 4K kernel stack for every task.

config TRIMEDIA_DP
	bool "TriMedia DP mechanism"
	default n
	help
	  Enble TriMedia debug print mechanism support

config TRIMEDIA_DPSIZE
	int "TriMedia DP buffer size(Kbyte)"
	depends on TRIMEDIA_DP
	default 64
	range 16 128
	help
	  Specify the buffer size used by TriMedia DP.

config FORCE_CHECK
	bool "Force check"
	default n
	help
	  Enable force check.	

source "mm/Kconfig"

endmenu

menu "Boot options"

config CMDLINE
        string "Default kernel command string"
        default ""
        help
          On TriMedia, there is currently no way for the boot loader to pass 
	  arguments to the kernel. For these architectures, you should supply 
          some command-line options at build time by entering them here. 
          As a minimum, you should specify the memory size and the root device 
          (e.g., mem=64M root=/dev/nfs).

config MEMSIZE
	int "System memory size(Mbyte)"
	default 256
	help
	  Board's memory size for Linux kernel.

config CPU_FREQ
	int "CPU Tick Rate"
	default 150000000
	help
	  Board's CPU tick rate.

config DYNLOAD
	bool "Enable Load appliations dynamically"
	default y
	help
	  To enable the linux kernel load applications dynamically.

config PAGE_OFFSET
	hex "Memory address offset"
	default 0
	help
	  Memory address offset for the kernel, for ttisim it usually is 0, for winnt host-side mode,
	  it is 0xe4000000 on LCP-1500 board.

endmenu

config ISA_DMA_API
	bool
	depends on !M5272
	default y

menu "Bus options (PCI, PCMCIA, EISA, MCA, ISA)"

config PCI
	bool "PCI support"
	help
	  Support for PCI bus.

config COMEMPCI
	bool "CO-MEM lite PCI controller support"
	depends on (M5307 || M5407)

source "drivers/pci/Kconfig"

source "drivers/pcmcia/Kconfig"

source "drivers/pci/hotplug/Kconfig"

endmenu

menu "Executable file formats"

source "fs/Kconfig.binfmt"

endmenu

menu "Power management options"

config PM
	bool "Power Management support"
	help
	  Support processor power management modes

endmenu

source "net/Kconfig"

source "drivers/Kconfig"

source "fs/Kconfig"

source "arch/m68knommu/Kconfig.debug"

source "security/Kconfig"

source "crypto/Kconfig"

source "lib/Kconfig"
```

## drivers/crypto/sec2/Kconfig
```kconfig
#
# SEC2.x support
#

config MPC8xxx_SEC2x
	bool "SEC2.x support for MPC8xxx processors"
	depends on MPC834x || MPC854x

config MPC8349E_SEC20
	tristate "SEC2.0 support"
	depends on MPC8xxx_SEC2x && MPC834x
	default M

config MPC854x_SEC21
	tristate "SEC2.1 support"
	depends on MPC8xxx_SEC2x && MPC854x
	default M
```

## drivers/crypto/sec2test/Kconfig
```kconfig
#
# SEC2.x driver testing support
#

config MPC8xxx_SEC2xTEST
	bool "SEC test support for MPC8xxx CPU"
	depends on MPC8xxx_SEC2x
	default Y

config MPC8349E_SEC20TEST
	tristate "MPC8349 SEC2.0 testing support"
	depends on MPC8xxx_SEC2xTEST && MPC8349E_SEC20
	default M

config MPC854x_SEC21TEST
	tristate "SEC2.1 testing support"
	depends on MPC8xxx_SEC2xTEST && MPC854x_SEC21
	default M
```

## drivers/net/dethernet/Kconfig
```kconfig
#
# Dethernet configuration
#
# This program is free software; you can redistribute it and/or
# modify it under the terms of the GNU General Public License
# as published by the Free Software Foundation; either version
# 2 of the License, or (at your option) any later version.
#

menu "Dethernet device"
	depends on MPC8540_EVAL && NETDEVICES
	
config DETHERNET
        bool "Dethernet driver support"
        ---help---
        Dethernet driver is a simulating ethernet driver for MPC8540EVAL
        board when it acts as PCI agent device.
        If MPC8540EVAL board acts as PCI agent and want to communicate
        with the host through PCI interface, enable this Dethernet driver
        and there will be an ethernet device named dethx in the system.
        Corporating with another ethernet device named dethx in the host
        system, the host and agent can send package to each other.

endmenu
```

## drivers/net/trimedia/Kconfig
```kconfig
#
# Trimedia network device configration for NXP on-chip hardware support
#
config NXP_LAN100
	bool "NXP LAN100 network device support"
	default n
	depends on NET_ETHERNET && TRIMEDIA && !TTISIM && ! OLD_TMSIM
	help 
	  If you wish to use LAN100 ethernet of PNX15xx/PNX17xx, then you should
          always answer Y to this.
```
